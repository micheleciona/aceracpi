## acer_acpi-upstream/Kconfig
```kconfig
config ACER_ACPI
	tristate "Acer Laptop ACPI Extras (EXPERIMENTAL)"
	depends on X86
	depends on ACPI
	depends on EXPERIMENTAL
	depends on LEDS_CLASS
	depends on BACKLIGHT_CLASS_DEVICE
	---help---
          This driver drives the PNP0C14 device found on many Acer laptops from
          2005 onwards (and known to work on some Fujitsu Siemens laptops). It
          adds support for wireless, bluetooth, backlight and mail LED control.

          For more information, see <file:Documentation/acer_acpi.txt>
          and read <http://code.google.com/p/aceracpi/wiki/SupportedHardware>
          for a list of hardware known to work with the driver.

          If you are not sure, say N here.
```
